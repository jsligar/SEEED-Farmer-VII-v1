## firmware/sdkconfig.defaults
```kconfig
CONFIG_FREERTOS_UNICORE=y
CONFIG_FREERTOS_HZ=1000
CONFIG_FREERTOS_TASK_STACK_SIZE=4096
CONFIG_PARTITION_TABLE_OFFSET=0x8000

# Console configuration
CONFIG_ESP_CONSOLE_USB_SERIAL_JTAG_ENABLED=y
CONFIG_ESP_CONSOLE_UART_DEFAULT=n
CONFIG_ESP_CONSOLE_UART_BAUDRATE=115200
CONFIG_ESP_CONSOLE_USB_CDC=n

CONFIG_USB_SERIAL_JTAG_ENABLED=y

# Log configuration
CONFIG_LOG_DEFAULT_LEVEL_INFO=y
CONFIG_LOG_COLORS=y

# SPI configuration
CONFIG_SPI_FLASH_ROM_DRIVER_PATCH=y

# Memory configuration 
CONFIG_ESP_MAIN_TASK_STACK_SIZE=8192
CONFIG_ESP_SYSTEM_EVENT_TASK_STACK_SIZE=4096

# NVS configuration
CONFIG_NVS_ENCRYPTION=n

# Component configurations
CONFIG_LWIP_PPP_SUPPORT=n
CONFIG_BT_ENABLED=n
CONFIG_WIFI_ENABLED=n
```
